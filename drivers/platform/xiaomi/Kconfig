## drivers/platform/xiaomi/Kconfig
```kconfig
# Xiaomi configuration options

config MACH_XIAOMI_SDM636
	bool "Xiaomi SDM636"
	depends on ARCH_SDM660
	help
	  Support for SDM636 Xiaomi variants

menu "Xiaomi board selection"

config MACH_XIAOMI_WHYRED
	bool "WhyRed board"
	select MACH_XIAOMI_SDM636
	help
	  Support for Redmi Note 5 Pro

endmenu
```
